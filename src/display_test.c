/**
 * @file io_test.c
 * @author Gabriel Germano (gabriel.germano@edge.ufal.br)
 * @brief
 * @version 0.1
 * @date 29-01-2026
 *
 * @copyright Copyright (c) 2026
 *
 */
#include "display.h"
#include "display_test.h"

#include "fonts.h"
#include "zephyr/devicetree.h"
#include <stdio.h>
#include <string.h>
#include <zephyr/device.h>
#include <zephyr/drivers/gpio.h>
#include <zephyr/drivers/uart.h>
#include <zephyr/kernel.h>
#include <zephyr/logging/log.h>
#include <zephyr/sys/ring_buffer.h>
#include <zephyr/shell/shell.h>

#define SLEEP_TIME_MS 10

static const struct gpio_dt_spec display_reset =
	GPIO_DT_SPEC_GET(DT_NODELABEL(display_reset), gpios);

static const struct gpio_dt_spec display_en = GPIO_DT_SPEC_GET(DT_NODELABEL(display_en), gpios);

static const unsigned char zbook_bitmap[] = {
	// 'Gemini_Generated_Image_mh1mqmh1mqmh1mqm, 100x50px
	0x00, 0x00, 0x00, 0x00, 0x00, 0x00, 0x00, 0x00, 0x00, 0x00, 0x00, 0x00, 0x00, 0x00, 0x00,
	0x00, 0x00, 0x00, 0x00, 0x00, 0x00, 0x00, 0x00, 0x00, 0x00, 0x00, 0x00, 0x00, 0x00, 0x00,
	0x00, 0x00, 0x00, 0x00, 0x00, 0x00, 0x00, 0x00, 0x00, 0x00, 0x00, 0x00, 0x00, 0x00, 0x00,
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	0x00, 0x00, 0x00, 0x00, 0x00};

static int init_pins(const struct shell *sh)
{
	int ret = gpio_pin_configure_dt(&display_reset, GPIO_OUTPUT_ACTIVE);
	if (ret < 0) {
		shell_fprintf(sh, SHELL_VT100_COLOR_RED, "reset pin configuration failed");
		return ret;
	}

	ret = gpio_pin_set_dt(&display_reset, 1);
	if (ret < 0) {
		shell_fprintf(sh, SHELL_VT100_COLOR_RED, "reset pin set failed");
		return ret;
	}

	ret = gpio_pin_configure_dt(&display_en, GPIO_OUTPUT_ACTIVE);
	if (ret < 0) {
		shell_fprintf(sh, SHELL_VT100_COLOR_RED, "enable pin configuration failed");
		return ret;
	}

	ret = gpio_pin_set_dt(&display_en, 1);
	if (ret < 0) {
		shell_fprintf(sh, SHELL_VT100_COLOR_RED, "enable pin set failed");
		return ret;
	}

	return 0;
}

static void display_clear_and_flush(void)
{
	int ret = gpio_pin_set_dt(&display_en, 0);
	if (ret < 0) {
		return;
	}

	ret = gpio_pin_set_dt(&display_reset, 1);
	if (ret < 0) {
		return;
	}

	ret = gpio_pin_set_dt(&display_reset, 0);
	if (ret < 0) {
		return;
	}
}

int cmd_test_display(const struct shell *sh, size_t argc, char **argv)
{
	int ret;
	display_init();

	ret = init_pins(sh);
	if (ret < 0) {
		shell_fprintf_impl(sh, SHELL_VT100_COLOR_RED, "pin initialization failed");
		return ret;
	}

	shell_fprintf_impl(sh, SHELL_VT100_COLOR_GREEN, "Pins initialized successfully\n");

	display_enable();

	display_clear();

	display_set_draw_mode(DISPLAY_PIXEL_WHITE);

	display_draw_circle(64, 32, 30);

	display_draw_circle(64, 32, 29);

	display_draw_circle(64, 32, 28);

	display_set_draw_mode(DISPLAY_PIXEL_INVERT);

	display_print("Hello, World!", 27, 19, FONT_SIZE_10, 1);

	display_set_draw_mode(DISPLAY_PIXEL_WHITE);

	display_flush();

	k_msleep(5000);

	display_clear();

	display_draw_bitmap(zbook_bitmap, 12, 7, 100, 50, 1);

	display_flush();

	k_msleep(5000);

	display_clear_and_flush();

	return 0;
}
