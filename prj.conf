## CMakeLists.txt
```
cmake_minimum_required(VERSION 3.20.0)

# The board (zbook/rp2350b/m33) comes from the `board` Zephyr module declared in
# west.yml — no BOARD_ROOT here. Select it at build time with `-b zbook/rp2350b/m33`.
find_package(Zephyr REQUIRED HINTS $ENV{ZEPHYR_BASE})
project(bringup LANGUAGES C)

include_directories(./include)

file(GLOB_RECURSE SRC ${CMAKE_SOURCE_DIR} "src/*.c")
target_sources(app PRIVATE ${SRC})
```

## west.yml
```
manifest:
        remotes:
                - name: zephyrproject
                  url-base: https://github.com/zephyrproject-rtos
                - name: zephyr-book
                  url-base: https://github.com/zephyr-book
                - name: edgebr
                  url-base: https://github.com/edgebr

        projects:
                - name: zephyr
                  remote: zephyrproject
                  revision: v4.4.0
                  clone-depth: 1
                  # path-prefix below also prepends to this project's own path,
                  # so `path: zephyr` resolves to deps/zephyr.
                  path: zephyr
                  import:
                          path-prefix: deps/
                          name-allowlist:
                                  - hal_rpi_pico
                                  - cmsis_6
                                  - fatfs
                                  - littlefs

                # Board support shipped as a Zephyr module (provides boards/ via module.yml).
                - name: zbook
                  remote: zephyr-book
                  revision: main

                - name: oled-mono-fonts
                  remote: edgebr
                  revision: zephyr
                  path: deps/modules/fonts/oled-mono-fonts

                - name: oled-sh1106-zephyr
                  remote: edgebr
                  revision: 3-wire-spi
                  clone-depth: 1
                  path: deps/modules/drivers/display

        self:
                path: bring-up-test-p1
```

## prj.conf
```kconfig
CONFIG_SENSOR=y
CONFIG_SHELL=y

CONFIG_PWM=y
CONFIG_PWM_RPI_PICO=y

CONFIG_ASSERT=y

CONFIG_OLED_DISPLAY=y
CONFIG_OLED_FONTS=y

CONFIG_SPI=y

CONFIG_HEAP_MEM_POOL_SIZE=32768

CONFIG_GPIO_SHELL=y

CONFIG_MAIN_STACK_SIZE=5200
CONFIG_SHELL_STACK_SIZE=5200

# Wi-Fi / networking lives on the zbook_wifi shield:
#   west build -b zbook/rp2350b/m33 --shield zbook_wifi
# Add persistent credentials by composing the upstream snippet:
#   west build -b zbook/rp2350b/m33 --shield zbook_wifi -S wifi-credentials
```

## src/main.c
```c
/**
 * @file main.c
 * @author Gabriel Germano (gabriel.germano@edge.ufal.br)
 * @brief
 * @version 0.1
 * @date 29-01-2026
 *
 * @copyright Copyright (c) 2026
 *
 */

#include "ldr_test.h"
#include "io_test.h"
#include "pwm_test.h"
#include "addr_led_test.h"
#include "ir_io_test.h"
#include "sd_test.h"
#include "display_test.h"

#include <stdlib.h>
#include <zephyr/drivers/uart.h>
#include <zephyr/kernel.h>
#include <zephyr/logging/log.h>
#include <zephyr/shell/shell.h>
#include <zephyr/shell/shell_types.h>

static int cmd_test_all(const struct shell *sh, size_t argc, char **argv)
{
	ARG_UNUSED(argc);
	ARG_UNUSED(argv);
	int ret;

	ret = cmd_test_ldr(sh, argc, argv);
	if (ret < 0) {
		shell_fprintf(sh, SHELL_VT100_COLOR_RED, "LDR test failed");
		return ret;
	}

	ret = cmd_test_io(sh, argc, argv);
	if (ret < 0) {
		shell_fprintf(sh, SHELL_VT100_COLOR_RED, "IO test failed");
		return ret;
	}

	ret = cmd_test_pwm(sh, argc, argv);
	if (ret < 0) {
		shell_fprintf(sh, SHELL_VT100_COLOR_RED, "PWM test failed");
		return ret;
	}

	ret = cmd_test_addr_led(sh, argc, argv);
	if (ret < 0) {
		shell_fprintf(sh, SHELL_VT100_COLOR_RED, "Addressable LED test failed");
		return ret;
	}

	ret = cmd_test_ir_io(sh, argc, argv);
	if (ret < 0) {
		shell_fprintf(sh, SHELL_VT100_COLOR_RED, "IR IO test failed");
		return ret;
	}

	shell_fprintf(sh, SHELL_VT100_COLOR_GREEN, "All tests passed successfully.");
	return 0;
}

SHELL_STATIC_SUBCMD_SET_CREATE(
	commands,
	SHELL_CMD_ARG(ldr, NULL, "Initialize the bringup test for LDR Module.", cmd_test_ldr, 1, 0),
	SHELL_CMD_ARG(io, NULL, "Initialize the bringup test for IO Module.", cmd_test_io, 1, 0),
	SHELL_CMD_ARG(pwm, NULL, "Initialize the bringup test for PWM Module.", cmd_test_pwm, 1, 0),
	SHELL_CMD_ARG(addr_led, NULL, "Initialize the bringup test for Addressable LED Module.",
		      cmd_test_addr_led, 1, 0),
	SHELL_CMD_ARG(display, NULL, "Initialize the bringup test for Display Module.",
		      cmd_test_display, 1, 0),
	SHELL_CMD_ARG(ir_io, NULL, "Initialize the bringup test for IR IO Module.", cmd_test_ir_io,
		      1, 0),
	SHELL_CMD_ARG(all, NULL, "Initialize the bringup test for all Modules.", cmd_test_all, 1,
		      0),
	SHELL_CMD_ARG(sd, NULL, "Initialize the bringup test for SD Card Module.", cmd_test_sd, 1,
		      0),
	SHELL_SUBCMD_SET_END /* Array terminated. */
);

SHELL_CMD_REGISTER(test, &commands, "Test bringup of Zbook", NULL);

static void list_available_tests(void)
{
	printk("Available tests:\n");
	printk("  test ldr\n");
	printk("  test io\n");
	printk("  test pwm\n");
	printk("  test addr_led\n");
	printk("  test display\n");
	printk("  test ir_io\n");
	printk("  test sd\n");
	printk("  test all\n");
}

int main(void)
{
	const struct device *dev;
	uint32_t dtr = 0;

	dev = DEVICE_DT_GET(DT_CHOSEN(zephyr_shell_uart));
	if (!device_is_ready(dev)) {
		return 0;
	}

	list_available_tests();

	while (!dtr) {
		uart_line_ctrl_get(dev, UART_LINE_CTRL_DTR, &dtr);
		k_sleep(K_MSEC(100));
	}
	return 0;
}
```

## include/addr_led_test.h
```c
#ifndef ADDR_LED_TEST_H
#define ADDR_LED_TEST_H

#include <zephyr/shell/shell.h>

int cmd_test_addr_led(const struct shell *sh, size_t argc, char **argv);

#endif /* ADDR_LED_TEST_H */
```

## include/display_test.h
```c
#ifndef DISPLAY_TEST_H
#define DISPLAY_TEST_H

#include <zephyr/shell/shell.h>
#include <display.h>

int cmd_test_display(const struct shell *sh, size_t argc, char **argv);

#endif /* DISPLAY_TEST_H */
```

## include/io_test.h
```c
#ifndef IO_TEST_H
#define IO_TEST_H

#include <zephyr/shell/shell.h>

int cmd_test_io(const struct shell *sh, size_t argc, char **argv);

#endif /* IO_TEST_H */
```

## include/ir_io_test.h
```c
#ifndef IR_IO_TEST_H
#define IR_IO_TEST_H

#include <zephyr/shell/shell.h>

int cmd_test_ir_io(const struct shell *sh, size_t argc, char **argv);

#endif /* IR_IO_TEST_H */
```

## include/ldr_test.h
```c
#ifndef LDR_TEST_H
#define LDR_TEST_H

#include <zephyr/shell/shell.h>

int cmd_test_ldr(const struct shell *sh, size_t argc, char **argv);

#endif /* LDR_TEST_H */
```

## include/pwm_test.h
```c
#ifndef PWM_TEST_H
#define PWM_TEST_H

#include <zephyr/shell/shell.h>

int cmd_test_pwm(const struct shell *sh, size_t argc, char **argv);

#endif /* PWM_TEST_H */
```

## include/sd_test.h
```c
#ifndef SD_TEST_H
#define SD_TEST_H

#include <zephyr/shell/shell.h>

int cmd_test_sd(const struct shell *sh, size_t argc, char **argv);

#endif /* SD_TEST_H */
```

## src/addr_led_test.c
```c
/**
 * @file led_strip_test.c
 * @author Vinicius Ramos (vinicius.ramos@edge.ufal.br)
 * @brief
 * @version 0.1
 * @date 23-02-2026
 *
 * @copyright Copyright (c) 2026
 *
 */
#include "addr_led_test.h"

#include "zephyr/devicetree.h"
#include <stdio.h>
#include <string.h>
#include <zephyr/device.h>
#include <zephyr/drivers/gpio.h>
#include <zephyr/drivers/uart.h>
#include <zephyr/drivers/led_strip.h>
#include <zephyr/drivers/spi.h>
#include <zephyr/kernel.h>
#include <zephyr/logging/log.h>
#include <zephyr/sys/ring_buffer.h>
#include <zephyr/shell/shell.h>

#define SLEEP_TIME_MS 10
#define SAMPLE_LED_BRIGHTNESS 0xFF
#define SAMPLE_LED_UPDATE_DELAY 50

#if DT_NODE_HAS_PROP(DT_ALIAS(led_strip), chain_length)
#define STRIP_NUM_PIXELS	DT_PROP(DT_ALIAS(led_strip), chain_length)
#else
#error Unable to determine length of LED strip
#endif

#define DELAY_TIME K_MSEC(SAMPLE_LED_UPDATE_DELAY)
#define RGB(_r, _g, _b) { .r = (_r), .g = (_g), .b = (_b) }

static const struct led_rgb colors[] = {
	RGB(SAMPLE_LED_BRIGHTNESS, 0x00, 0x00), /* red */
	RGB(0x00, SAMPLE_LED_BRIGHTNESS, 0x00), /* green */
	RGB(0x00, 0x00, SAMPLE_LED_BRIGHTNESS), /* blue */
};

static struct led_rgb pixels[STRIP_NUM_PIXELS];

static const struct device *const led_strip = DEVICE_DT_GET(DT_ALIAS(led_strip));

static const struct gpio_dt_spec up_button = GPIO_DT_SPEC_GET(DT_NODELABEL(button1), gpios);
static const struct gpio_dt_spec down_button = GPIO_DT_SPEC_GET(DT_NODELABEL(button4), gpios);
static const struct gpio_dt_spec right_button = GPIO_DT_SPEC_GET(DT_NODELABEL(button2), gpios);

static int init_buttons(const struct shell *sh)
{
	int ret;

    if (!gpio_is_ready_dt(&up_button)) {
        shell_error(sh, "Up Button device not ready");
        return -ENODEV;
    }

    ret = gpio_pin_configure_dt(&up_button, GPIO_INPUT);
    if (ret < 0) {
        shell_error(sh, "Failed to configure up button: %d", ret);
        return ret;
    }

    if (!gpio_is_ready_dt(&down_button)) {
        shell_error(sh, "Down Button device not ready");
        return -ENODEV;
    }

    ret = gpio_pin_configure_dt(&down_button, GPIO_INPUT);
    if (ret < 0) {
        shell_error(sh, "Failed to configure down button: %d", ret);
        return ret;
    }

    if (!gpio_is_ready_dt(&right_button)) {
        shell_error(sh, "Right Button device not ready");
        return -ENODEV;
    }

    ret = gpio_pin_configure_dt(&right_button, GPIO_INPUT);
    if (ret < 0) {
        shell_error(sh, "Failed to configure right button: %d", ret);
        return ret;
    }

	shell_fprintf(sh, SHELL_VT100_COLOR_GREEN, "Buttons initialized\n");
	return 0;
}

static int init_addr_led(void)
{
    if (!device_is_ready(led_strip)) {
        return -ENODEV;
    }

    return 0;
}

int cmd_test_addr_led(const struct shell *sh, size_t argc, char **argv)
{
	ARG_UNUSED(argc);
	ARG_UNUSED(argv);
	int ret, previous_state_up = 0, previous_state_down = 0, previous_state_right = 0;
    size_t color = 0;
    bool test_passed = true;

    ret = init_addr_led();
    if (ret < 0) {
        shell_error(sh, "Addressable LED device not ready: %d", ret);
        return ret;
    }

    ret = init_buttons(sh);
	if (ret < 0) {
		shell_error(sh, "Buttons initialization failed: %d\n", ret);
		return ret;
	}

	shell_fprintf(sh, SHELL_VT100_COLOR_GREEN, "Addressable LED Test started, press the UP key if test passed, DOWN if test failed\n");

	while (1) {
        for (size_t cursor = 0; cursor < ARRAY_SIZE(pixels); cursor++) {
			memset(&pixels, 0x00, sizeof(pixels));
			memcpy(&pixels[cursor], &colors[color], sizeof(struct led_rgb));

			ret = led_strip_update_rgb(led_strip, pixels, STRIP_NUM_PIXELS);
			if (ret) {
                shell_error(sh, "Couldn't update LED strip: %d\n", ret);
                return ret;
            }

			k_sleep(DELAY_TIME);
		}

        int current_up = gpio_pin_get_dt(&up_button);
        int current_down = gpio_pin_get_dt(&down_button);
        int current_right = gpio_pin_get_dt(&right_button);

        if (current_up == 1 && previous_state_up == 0) {
            shell_fprintf(sh, SHELL_NORMAL,
                        "Up button pressed -> TEST PASSED\n");
            break;
        }

        if (current_down == 1 && previous_state_down == 0) {
            shell_fprintf(sh, SHELL_NORMAL,
                        "Down button pressed -> TEST FAILED\n");
            test_passed = false;
            break;
        }

        if (current_right == 1 && previous_state_right == 0) {
            shell_fprintf(sh, SHELL_NORMAL,
                        "Right button pressed -> Change color\n");
            color = (color + 1) % ARRAY_SIZE(colors);
        }

        previous_state_up = current_up;
        previous_state_down = current_down;
        previous_state_right = current_right;
		k_msleep(SLEEP_TIME_MS);
	}

    memset(&pixels, 0x00, sizeof(pixels));
    ret = led_strip_update_rgb(led_strip, pixels, STRIP_NUM_PIXELS);
    if (ret) {
        shell_error(sh, "Couldn't update LED strip: %d\n", ret);
        return ret;
    }

    if (test_passed) {
        shell_fprintf(sh, SHELL_VT100_COLOR_GREEN, "Addressable LED test passed successfully.\n");
        return 0;
    } else {
        shell_fprintf(sh, SHELL_VT100_COLOR_RED, "Addressable LED test failed.\n");
        return -1;
    }
}
```

## src/display_test.c
```c
/**
 * @file io_test.c
 * @author Gabriel Germano (gabriel.germano@edge.ufal.br)
 * @brief
 * @version 0.1
 * @date 29-01-2026
 *
 * @copyright Copyright (c) 2026
 *
 */
#include "display.h"
#include "display_test.h"

#include "fonts.h"
#include "zephyr/devicetree.h"
#include <stdio.h>
#include <string.h>
#include <zephyr/device.h>
#include <zephyr/drivers/gpio.h>
#include <zephyr/drivers/uart.h>
#include <zephyr/kernel.h>
#include <zephyr/logging/log.h>
#include <zephyr/sys/ring_buffer.h>
#include <zephyr/shell/shell.h>

#define SLEEP_TIME_MS 10

static const struct gpio_dt_spec display_reset =
	GPIO_DT_SPEC_GET(DT_NODELABEL(display_reset), gpios);

static const struct gpio_dt_spec display_en = GPIO_DT_SPEC_GET(DT_NODELABEL(display_en), gpios);

static const unsigned char zbook_bitmap[] = {
	// 'Gemini_Generated_Image_mh1mqmh1mqmh1mqm, 100x50px
	0x00, 0x00, 0x00, 0x00, 0x00, 0x00, 0x00, 0x00, 0x00, 0x00, 0x00, 0x00, 0x00, 0x00, 0x00,
	0x00, 0x00, 0x00, 0x00, 0x00, 0x00, 0x00, 0x00, 0x00, 0x00, 0x00, 0x00, 0x00, 0x00, 0x00,
	0x00, 0x00, 0x00, 0x00, 0x00, 0x00, 0x00, 0x00, 0x00, 0x00, 0x00, 0x00, 0x00, 0x00, 0x00,
	0x00, 0x00, 0x00, 0x00, 0x00, 0x00, 0x00, 0x00, 0x00, 0x00, 0x00, 0x00, 0x00, 0x00, 0x00,
	0x00, 0x00, 0x00, 0x00, 0x00, 0x00, 0x00, 0x00, 0x00, 0x00, 0x00, 0x00, 0x00, 0x00, 0x00,
	0x00, 0x00, 0x00, 0x00, 0x00, 0x00, 0x00, 0x00, 0x00, 0x00, 0x00, 0x00, 0x00, 0x00, 0x00,
	0x00, 0x00, 0x00, 0x00, 0x00, 0x00, 0x00, 0x00, 0x00, 0x00, 0x00, 0x00, 0x00, 0x00, 0x00,
	0x00, 0x00, 0x00, 0x00, 0x00, 0x00, 0x00, 0x00, 0x00, 0x00, 0x00, 0x00, 0x00, 0x00, 0x00,
	0x00, 0x00, 0x00, 0x00, 0x00, 0x00, 0x00, 0x00, 0x00, 0x00, 0x00, 0x00, 0x00, 0x00, 0x00,
	0x00, 0x00, 0x00, 0x00, 0x00, 0x00, 0x00, 0x00, 0x00, 0x00, 0x00, 0x00, 0x00, 0x00, 0x00,
	0x00, 0x00, 0x00, 0x00, 0x00, 0x00, 0x00, 0x00, 0x00, 0x00, 0x00, 0x00, 0x00, 0x00, 0x00,
	0x00, 0x00, 0x00, 0x00, 0x00, 0x00, 0x00, 0x00, 0x00, 0x00, 0x00, 0x00, 0x00, 0x00, 0x00,
	0x00, 0x00, 0x00, 0x00, 0x07, 0xff, 0xfe, 0x00, 0x00, 0x00, 0x00, 0x00, 0x00, 0x00, 0x00,
	0x00, 0x00, 0x0f, 0xff, 0xfc, 0x00, 0x00, 0x00, 0x00, 0x00, 0x00, 0x00, 0x00, 0x00, 0x00,
	0x1f, 0xff, 0xfc, 0x00, 0x00, 0x00, 0x00, 0x00, 0x00, 0x00, 0x00, 0x00, 0x00, 0x1f, 0xff,
	0xf8, 0x00, 0x00, 0x00, 0x00, 0x00, 0x00, 0x00, 0x00, 0x00, 0x00, 0x00, 0x01, 0xf0, 0x60,
	0x00, 0x00, 0x00, 0x30, 0x00, 0x00, 0x00, 0x00, 0x00, 0x00, 0x03, 0xe0, 0x60, 0x00, 0x00,
	0x00, 0x30, 0x00, 0x00, 0x00, 0x00, 0x00, 0x00, 0x03, 0xc0, 0x60, 0x00, 0x00, 0x00, 0x30,
	0x00, 0x00, 0x00, 0x00, 0x00, 0x00, 0x27, 0xc0, 0x60, 0x00, 0x00, 0x00, 0x30, 0x00, 0x00,
	0x00, 0x00, 0x00, 0x00, 0x2f, 0x80, 0x6f, 0x83, 0xe0, 0x7c, 0x30, 0xc0, 0x00, 0x00, 0x00,
	0x00, 0x00, 0x5f, 0x00, 0x7f, 0xc7, 0xf8, 0xfe, 0x31, 0x80, 0x00, 0x00, 0x00, 0x00, 0x00,
	0x7e, 0x00, 0x70, 0xce, 0x19, 0xc3, 0x33, 0x80, 0x00, 0x00, 0x00, 0x00, 0x00, 0xfe, 0x00,
	0x60, 0x6c, 0x0d, 0x83, 0xb7, 0x00, 0x00, 0x00, 0x00, 0x00, 0x00, 0xfc, 0x00, 0x60, 0x6c,
	0x0d, 0x81, 0xbe, 0x00, 0x00, 0x00, 0x00, 0x00, 0x01, 0xf8, 0x00, 0x60, 0x6c, 0x0d, 0x81,
	0xbf, 0x00, 0x00, 0x00, 0x00, 0x00, 0x03, 0xf0, 0x00, 0x60, 0x6c, 0x1d, 0x83, 0x39, 0x80,
	0x00, 0x00, 0x00, 0x00, 0x03, 0xe0, 0x00, 0x70, 0xc6, 0x19, 0xc3, 0x31, 0xc0, 0x00, 0x00,
	0x00, 0x00, 0x07, 0xe0, 0x00, 0x7f, 0xc7, 0xf0, 0xfe, 0x30, 0xc0, 0x00, 0x00, 0x00, 0x00,
	0x0f, 0xc0, 0x00, 0x67, 0x01, 0xe0, 0x3c, 0x30, 0x60, 0x00, 0x00, 0x00, 0x00, 0x0f, 0xff,
	0xf8, 0x00, 0x00, 0x00, 0x00, 0x00, 0x00, 0x00, 0x00, 0x00, 0x00, 0x1f, 0xff, 0xf0, 0x00,
	0x00, 0x00, 0x00, 0x00, 0x00, 0x00, 0x00, 0x00, 0x00, 0x3f, 0xff, 0xf0, 0x00, 0x00, 0x00,
	0x00, 0x00, 0x00, 0x00, 0x00, 0x00, 0x00, 0x3f, 0xff, 0xe0, 0x00, 0x00, 0x00, 0x00, 0x00,
	0x00, 0x00, 0x00, 0x00, 0x00, 0x00, 0x00, 0x00, 0x00, 0x00, 0x00, 0x00, 0x00, 0x00, 0x00,
	0x00, 0x00, 0x00, 0x00, 0x00, 0x00, 0x00, 0x00, 0x00, 0x00, 0x00, 0x00, 0x00, 0x00, 0x00,
	0x00, 0x00, 0x00, 0x00, 0x00, 0x00, 0x00, 0x00, 0x00, 0x00, 0x00, 0x00, 0x00, 0x00, 0x00,
	0x00, 0x00, 0x00, 0x00, 0x00, 0x00, 0x00, 0x00, 0x00, 0x00, 0x00, 0x00, 0x00, 0x00, 0x00,
	0x00, 0x00, 0x00, 0x00, 0x00, 0x00, 0x00, 0x00, 0x00, 0x00, 0x00, 0x00, 0x00, 0x00, 0x00,
	0x00, 0x00, 0x00, 0x00, 0x00, 0x00, 0x00, 0x00, 0x00, 0x00, 0x00, 0x00, 0x00, 0x00, 0x00,
	0x00, 0x00, 0x00, 0x00, 0x00, 0x00, 0x00, 0x00, 0x00, 0x00, 0x00, 0x00, 0x00, 0x00, 0x00,
	0x00, 0x00, 0x00, 0x00, 0x00, 0x00, 0x00, 0x00, 0x00, 0x00, 0x00, 0x00, 0x00, 0x00, 0x00,
	0x00, 0x00, 0x00, 0x00, 0x00, 0x00, 0x00, 0x00, 0x00, 0x00, 0x00, 0x00, 0x00, 0x00, 0x00,
	0x00, 0x00, 0x00, 0x00, 0x00, 0x00, 0x00, 0x00, 0x00, 0x00, 0x00, 0x00, 0x00, 0x00, 0x00,
	0x00, 0x00, 0x00, 0x00, 0x00, 0x00, 0x00, 0x00, 0x00, 0x00, 0x00, 0x00, 0x00, 0x00, 0x00,
	0x00, 0x00, 0x00, 0x00, 0x00, 0x00, 0x00, 0x00, 0x00, 0x00, 0x00, 0x00, 0x00, 0x00, 0x00,
	0x00, 0x00, 0x00, 0x00, 0x00};

static int init_pins(const struct shell *sh)
{
	int ret = gpio_pin_configure_dt(&display_reset, GPIO_OUTPUT_ACTIVE);
	if (ret < 0) {
		shell_fprintf(sh, SHELL_VT100_COLOR_RED, "reset pin configuration failed");
		return ret;
	}

	ret = gpio_pin_set_dt(&display_reset, 1);
	if (ret < 0) {
		shell_fprintf(sh, SHELL_VT100_COLOR_RED, "reset pin set failed");
		return ret;
	}

	ret = gpio_pin_configure_dt(&display_en, GPIO_OUTPUT_ACTIVE);
	if (ret < 0) {
		shell_fprintf(sh, SHELL_VT100_COLOR_RED, "enable pin configuration failed");
		return ret;
	}

	ret = gpio_pin_set_dt(&display_en, 1);
	if (ret < 0) {
		shell_fprintf(sh, SHELL_VT100_COLOR_RED, "enable pin set failed");
		return ret;
	}

	return 0;
}

static void display_clear_and_flush(void)
{
	int ret = gpio_pin_set_dt(&display_en, 0);
	if (ret < 0) {
		return;
	}

	ret = gpio_pin_set_dt(&display_reset, 1);
	if (ret < 0) {
		return;
	}

	ret = gpio_pin_set_dt(&display_reset, 0);
	if (ret < 0) {
		return;
	}
}

int cmd_test_display(const struct shell *sh, size_t argc, char **argv)
{
	int ret;
	display_init();

	ret = init_pins(sh);
	if (ret < 0) {
		shell_fprintf_impl(sh, SHELL_VT100_COLOR_RED, "pin initialization failed");
		return ret;
	}

	shell_fprintf_impl(sh, SHELL_VT100_COLOR_GREEN, "Pins initialized successfully\n");

	display_enable();

	display_clear();

	display_set_draw_mode(DISPLAY_PIXEL_WHITE);

	display_draw_circle(64, 32, 30);

	display_draw_circle(64, 32, 29);

	display_draw_circle(64, 32, 28);

	display_set_draw_mode(DISPLAY_PIXEL_INVERT);

	display_print("Hello, World!", 27, 19, FONT_SIZE_10, 1);

	display_set_draw_mode(DISPLAY_PIXEL_WHITE);

	display_flush();

	k_msleep(5000);

	display_clear();

	display_draw_bitmap(zbook_bitmap, 12, 7, 100, 50, 1);

	display_flush();

	k_msleep(5000);

	display_clear_and_flush();

	return 0;
}
```

## src/io_test.c
```c
/**
 * @file io_test.c
 * @author Gabriel Germano (gabriel.germano@edge.ufal.br)
 * @brief
 * @version 0.1
 * @date 29-01-2026
 *
 * @copyright Copyright (c) 2026
 *
 */
#include "io_test.h"

#include "zephyr/devicetree.h"
#include <stdio.h>
#include <string.h>
#include <zephyr/device.h>
#include <zephyr/drivers/gpio.h>
#include <zephyr/drivers/uart.h>
#include <zephyr/kernel.h>
#include <zephyr/logging/log.h>
#include <zephyr/sys/ring_buffer.h>
#include <zephyr/shell/shell.h>

#define SLEEP_TIME_MS 10

static const struct gpio_dt_spec led_red = GPIO_DT_SPEC_GET(DT_NODELABEL(red_led), gpios);
static const struct gpio_dt_spec led_green = GPIO_DT_SPEC_GET(DT_NODELABEL(green_led), gpios);
static const struct gpio_dt_spec led_blue = GPIO_DT_SPEC_GET(DT_NODELABEL(blue_led), gpios);
static const struct gpio_dt_spec led_yellow = GPIO_DT_SPEC_GET(DT_NODELABEL(yellow_led), gpios);

static const struct gpio_dt_spec button_left = GPIO_DT_SPEC_GET(DT_NODELABEL(button3), gpios);
static const struct gpio_dt_spec button_right = GPIO_DT_SPEC_GET(DT_NODELABEL(button2), gpios);
static const struct gpio_dt_spec button_up = GPIO_DT_SPEC_GET(DT_NODELABEL(button1), gpios);
static const struct gpio_dt_spec button_down = GPIO_DT_SPEC_GET(DT_NODELABEL(button4), gpios);

static const struct gpio_dt_spec leds[] = {led_red, led_green, led_blue, led_yellow};

static const struct gpio_dt_spec buttons[] = {button_left, button_right, button_up, button_down};

static const char *button_names[] = {"LEFT", "RIGHT", "UP", "DOWN"};
static const char *led_names[] = {"RED", "GREEN", "BLUE", "YELLOW"};

static int init_leds(const struct shell *sh)
{
	int ret;

	for (size_t i = 0; i < ARRAY_SIZE(leds); i++) {
		if (!gpio_is_ready_dt(&leds[i])) {
			shell_error(sh, "LED %s device not ready", led_names[i]);
			return -ENODEV;
		}

		ret = gpio_pin_configure_dt(&leds[i], GPIO_OUTPUT_INACTIVE);
		if (ret < 0) {
			shell_error(sh, "Failed to configure LED %s: %d", led_names[i], ret);
			return ret;
		}
	}

	shell_fprintf(sh, SHELL_VT100_COLOR_GREEN, "LEDs initialized\n");
	return 0;
}

static int init_buttons(const struct shell *sh)
{
	int ret;

	for (size_t i = 0; i < ARRAY_SIZE(buttons); i++) {
		if (!gpio_is_ready_dt(&buttons[i])) {
			shell_error(sh, "Button %s device not ready", button_names[i]);
			return -ENODEV;
		}

		ret = gpio_pin_configure_dt(&buttons[i], GPIO_INPUT);
		if (ret < 0) {
			shell_error(sh, "Failed to configure button %s: %d", button_names[i], ret);
			return ret;
		}
	}

	shell_fprintf(sh, SHELL_VT100_COLOR_GREEN, "Buttons initialized\n");
	return 0;
}

int cmd_test_io(const struct shell *sh, size_t argc, char **argv)
{
	ARG_UNUSED(argc);
	ARG_UNUSED(argv);
	int ret;
	bool previous_state[ARRAY_SIZE(buttons)] = {0};

	ret = init_leds(sh);
	if (ret < 0) {
		shell_error(sh, "LED initialization failed: %d", ret);
		return ret;
	}

	ret = init_buttons(sh);
	if (ret < 0) {
		shell_error(sh, "Button initialization failed: %d", ret);
		return ret;
	}

	shell_fprintf(sh, SHELL_VT100_COLOR_GREEN, "IO Test started, press any key to stop\n");
	shell_fprintf(sh, SHELL_NORMAL, "Press buttons to toggle corresponding LEDs\n");

	while (1) {
		for (size_t i = 0; i < ARRAY_SIZE(buttons); i++) {
			int current = gpio_pin_get_dt(&buttons[i]);

			/* Detect falling edge (button press if ACTIVE_LOW) */
			if (current == 1 && previous_state[i] == 0) {
				gpio_pin_toggle_dt(&leds[i]);
				shell_fprintf(sh, SHELL_NORMAL,
					      "Button %s pressed -> LED %s toggled\n",
					      button_names[i], led_names[i]);
			}

			previous_state[i] = current;
		}

		k_msleep(SLEEP_TIME_MS);

		/* Stop the test when the button is pressed for 2 seconds btn1 (UP) */
		if (previous_state[2] == 1 && gpio_pin_get_dt(&buttons[2]) == 1) {
			k_sleep(K_SECONDS(2));
			if (gpio_pin_get_dt(&buttons[2]) == 1) {
				shell_fprintf(sh, SHELL_VT100_COLOR_GREEN, "\nIO Test stopped\n");
				break;
			}
		}

	}

	for (size_t i = 0; i < ARRAY_SIZE(leds); i++) {
		gpio_pin_set_dt(&leds[i], 0);
	}

	shell_fprintf(sh, SHELL_VT100_COLOR_GREEN, "\nIO Test completed\n");

	return 0;
}
```

## src/ir_io_test.c
```c
/**
 * @file io_test.c
 * @author Gabriel Germano (gabriel.germano@edge.ufal.br)
 * @brief
 * @version 0.1
 * @date 29-01-2026
 *
 * @copyright Copyright (c) 2026
 *
 */
#include "ir_io_test.h"

#include "zephyr/devicetree.h"
#include <stdio.h>
#include <string.h>
#include <zephyr/device.h>
#include <zephyr/drivers/gpio.h>
#include <zephyr/drivers/uart.h>
#include <zephyr/kernel.h>
#include <zephyr/logging/log.h>
#include <zephyr/sys/ring_buffer.h>
#include <zephyr/shell/shell.h>

#define SLEEP_TIME_MS 10

static const struct gpio_dt_spec ir_emitter = GPIO_DT_SPEC_GET(DT_NODELABEL(ir_emitter), gpios);
static const struct gpio_dt_spec ir_receiver = GPIO_DT_SPEC_GET(DT_NODELABEL(ir_receiver), gpios);
static const struct gpio_dt_spec led = GPIO_DT_SPEC_GET(DT_NODELABEL(blue_led), gpios);

static const struct gpio_dt_spec button_up = GPIO_DT_SPEC_GET(DT_NODELABEL(button1), gpios);
static const struct gpio_dt_spec button_down = GPIO_DT_SPEC_GET(DT_NODELABEL(button4), gpios);

static int init_leds(const struct shell *sh)
{
	int ret;

	if (!gpio_is_ready_dt(&led)) {
		shell_error(sh, "LED device not ready");
		return -ENODEV;
	}

	ret = gpio_pin_configure_dt(&led, GPIO_OUTPUT_INACTIVE);
	if (ret < 0) {
		shell_error(sh, "Failed to configure LED: %d\n", ret);
		return ret;
	}

	if (!gpio_is_ready_dt(&ir_emitter)) {
		shell_error(sh, "IR emitter device not ready");
		return -ENODEV;
	}

	ret = gpio_pin_configure_dt(&ir_emitter, GPIO_OUTPUT_INACTIVE);
	if (ret < 0) {
		shell_error(sh, "Failed to configure IR emitter: %d\n", ret);
		return ret;
	}

	shell_fprintf(sh, SHELL_VT100_COLOR_GREEN, "IR emitter initialized\n");
	return 0;
}

static int init_inputs(const struct shell *sh)
{
	int ret;

	if (!gpio_is_ready_dt(&button_up)) {
		shell_error(sh, "Button UP device not ready\n");
		return -ENODEV;
	}

	ret = gpio_pin_configure_dt(&button_up, GPIO_INPUT);
	if (ret < 0) {
		shell_error(sh, "Failed to configure button UP: %d\n", ret);
		return ret;
	}

	if (!gpio_is_ready_dt(&button_down)) {
		shell_error(sh, "Button DOWN device not ready\n");
		return -ENODEV;
	}

	ret = gpio_pin_configure_dt(&button_down, GPIO_INPUT);
	if (ret < 0) {
		shell_error(sh, "Failed to configure button DOWN: %d\n", ret);
		return ret;
	}

	ret = gpio_pin_configure_dt(&ir_receiver, GPIO_INPUT);
	if (ret < 0) {
		shell_error(sh, "Failed to configure IR receiver: %d\n", ret);
		return ret;
	}

	shell_fprintf(sh, SHELL_VT100_COLOR_GREEN, "Inputs initialized\n");
	return 0;
}

int cmd_test_ir_io(const struct shell *sh, size_t argc, char **argv)
{
	ARG_UNUSED(argc);
	ARG_UNUSED(argv);
	int ret;
	bool previous_state_up = 0, previous_state_down = 0;

	ret = init_leds(sh);
	if (ret < 0) {
		shell_error(sh, "LED initialization failed: %d", ret);
		return ret;
	}

	ret = init_inputs(sh);
	if (ret < 0) {
		shell_error(sh, "Button initialization failed: %d", ret);
		return ret;
	}

	shell_fprintf(sh, SHELL_VT100_COLOR_GREEN, "IR IO Test started\n");
	shell_fprintf(sh, SHELL_NORMAL, "Press UP button to toggle IR emitter, DOWN to pass test\n");

	while (1) {
		
		int current = gpio_pin_get_dt(&button_up);

		/* Detect falling edge (button press if ACTIVE_LOW) */
		if (current == 1 && previous_state_up == 0) {
			gpio_pin_toggle_dt(&ir_emitter);
			shell_fprintf(sh, SHELL_NORMAL,
						"Button UP pressed -> IR emitter toggled\n");
		}	
		previous_state_up = current;

		if (gpio_pin_get_dt(&ir_receiver) == 1) {
			gpio_pin_set_dt(&led, 1);
		} else {
			gpio_pin_set_dt(&led, 0);
		}

		current = gpio_pin_get_dt(&button_down);
		if (current == 1 && previous_state_down == 0) {
			gpio_pin_toggle_dt(&ir_emitter);
			shell_fprintf(sh, SHELL_NORMAL,
						"Button DOWN pressed -> Passing test...\n");
			break;
		}	
		previous_state_down = current;

		k_msleep(SLEEP_TIME_MS);
	}

	gpio_pin_set_dt(&ir_emitter, 0);
	gpio_pin_set_dt(&led, 0);

	shell_fprintf(sh, SHELL_VT100_COLOR_GREEN, "\nIR IO Test completed\n");

	return 0;
}
```

## src/ldr_test.c
```c
/**
 * @file ldr_test.c
 * @author Gabriel Germano (gabriel.germano@edge.ufal.br)
 * @brief
 * @version 0.1
 * @date 29-01-2026
 *
 * @copyright Copyright (c) 2026
 *
 */
#include "ldr_test.h"
#include <zephyr/devicetree.h>

#include <zephyr/drivers/pwm.h>
#include <zephyr/drivers/adc.h>
#include <zephyr/shell/shell.h>
#include <zephyr/shell/shell_types.h>
#include <zephyr/device.h>
#include <zephyr/kernel.h>

static const struct adc_channel_cfg ldr_adc = ADC_CHANNEL_CFG_DT(DT_NODELABEL(ldr_adc));

static const struct pwm_dt_spec pwm_buzzer = PWM_DT_SPEC_GET(DT_ALIAS(pwm_buzzer));

static const struct device *adc_dev = DEVICE_DT_GET(DT_NODELABEL(adc));

static int init_ldr_adc_test(const struct shell *sh)
{
	int ret;
	uint32_t frequency, period_ns, pulse_ns;
	int32_t voltage_mv;
	uint16_t adc_buffer = 0;
	struct adc_sequence sequence = {
		.buffer = &adc_buffer,
		.buffer_size = sizeof(adc_buffer),
		.calibrate = true,
		.channels = BIT(ldr_adc.channel_id),
		.resolution = 12,
	};

	if (!pwm_is_ready_dt(&pwm_buzzer)) {
		shell_fprintf(sh, SHELL_VT100_COLOR_RED, "PWM device not ready");
		return -ENODEV;
	}

	if (!device_is_ready(adc_dev)) {
		shell_fprintf(sh, SHELL_VT100_COLOR_RED, "ADC device not ready");
		return -ENODEV;
	}

	ret = adc_channel_setup(adc_dev, &ldr_adc);
	if (ret < 0) {
		shell_fprintf(sh, SHELL_VT100_COLOR_RED, "Failed to setup ADC channel");
		return ret;
	}

	shell_fprintf(sh, SHELL_VT100_COLOR_GREEN, "ADC Test initialized.\n");
	shell_fprintf(sh, SHELL_NORMAL, "Reading LDR and adjusting PWM frequency\n");

	while (true) {
		shell_fprintf(sh, SHELL_NORMAL, "Reading ADC...\n");
		ret = adc_read(adc_dev, &sequence);
		if (ret < 0) {
			shell_error(sh, "ADC read failed: %d", ret);
			return ret;
		}

		shell_fprintf(sh, SHELL_VT100_COLOR_GREEN, "ADC read successful: %d\n", adc_buffer);

		voltage_mv = adc_buffer;
		ret = adc_raw_to_millivolts(3300, ADC_GAIN_1, 12, &voltage_mv);
		if (ret < 0) {
			shell_error(sh, "ADC conversion failed: %d", ret);
			return ret;
		}

		shell_fprintf(sh, SHELL_NORMAL, "Raw ADC: %d, Voltage: %d mV\r", adc_buffer,
			      voltage_mv);

		frequency = 100 + (1000 * voltage_mv) / 3300;
		
		period_ns = NSEC_PER_SEC / frequency;
		pulse_ns = period_ns / 2;

		ret = pwm_set_dt(&pwm_buzzer, period_ns, pulse_ns);
		if (ret < 0) {
			shell_error(sh, "PWM set failed: %d", ret);
			return ret;
		}

		shell_fprintf(sh, SHELL_NORMAL, "Voltage: %d mV, Frequency: %d Hz\r", voltage_mv,
			      frequency);

		k_sleep(K_MSEC(20));
	}

	shell_fprintf(sh, SHELL_VT100_COLOR_GREEN, "\nPWM Test completed\n");

	return 0;
}


int cmd_test_ldr(const struct shell *sh, size_t argc, char **argv)
{
	ARG_UNUSED(argc);
	ARG_UNUSED(argv);
	int ret;

	ret = init_ldr_adc_test(sh);
	if (ret < 0) {
		shell_fprintf(sh, SHELL_VT100_COLOR_RED, "LDR ADC Test failed with error: %d\n", ret);
		return ret;
	}

	shell_fprintf(sh, SHELL_VT100_COLOR_GREEN, "PWM Test successful\n");

	return 0;
}
```
